#include "OLED.h"

/*****************OLED*****************/
//*SCl<----->PB5
//*SDA<----->PB6
//*RST<----->PB7
//*DC <----->PB8
//*
/***************************************/
/*
4线SPI使用说明：
VBT 供内部DC-DC电压，3.3~4.3V，如果使用5V电压，为保险起见串一个100~500欧的电阻
VCC 供内部逻辑电压 1.8~6V   
GND 地

BS0 低电平
BS1 低电平
BS2 低电平

CS  片选管脚
DC  命令数据选择管脚
RES 模块复位管脚 
D0（SCLK） ，时钟脚，由MCU控制
D1（MOSI） ，主输出从输入数据脚，由MCU控制

D2 悬空      
D3-D7 ， 低电平 ， 也可悬空，但最好设为低电平
RD  低电平 ，也可悬空，但最好设为低电平
RW  低电平 ，也可悬空，但最好设为低电平
RD  低电平 ，也可悬空，但最好设为低电平   
*/

#define X_WIDTH 128
#define Y_WIDTH 64
//======================================
const byte F6x8[][6] =
{
    { 0x00, 0x00, 0x00, 0x00, 0x00, 0x00 },   // sp  0
    { 0x00, 0x00, 0x00, 0x2f, 0x00, 0x00 },   // !   1
    { 0x00, 0x00, 0x07, 0x00, 0x07, 0x00 },   // "   2
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    { 0x14, 0x14, 0x14, 0x14, 0x14, 0x14 }    // horiz lines
};

//======================================================
// 128X64I液晶底层驱动[8X16]字体库
// 设计者: powerint
// 描  述: [8X16]西文字符的字模数据 (纵向取模,字节倒序)
// !"#$%&'()*+,-./0123456789:;<=>?@ABCDEFGHIJKLMNOPQRSTUVWXYZ[\]^_`abcdefghijklmnopqrstuvwxyz{|}~
//======================================================
const byte F8X16[]=
{
  0x00,0x00,0x00,0x00,0x00,0x00,0x00,0x00,0x00,0x00,0x00,0x00,0x00,0x00,0x00,0x00,// 0
  0x00,0x00,0x00,0xF8,0x00,0x00,0x00,0x00,0x00,0x00,0x00,0x33,0x30,0x00,0x00,0x00,//!1
  0x00,0x10,0x0C,0x06,0x10,0x0C,0x06,0x00,0x00,0x00,0x00,0x00,0x00,0x00,0x00,0x00,//"2
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  0x00,0x06,0x01,0x01,0x02,0x02,0x04,0x04,0x00,0x00,0x00,0x00,0x00,0x00,0x00,0x00,//~94

};



void LCD_WrDat(byte data)
{
  byte i=8;
  //LCD_CS=0;;
  LCD_DC_H;
 // asm("nop");asm("nop");
	__nop();__nop();
  LCD_SCL_L;
//  asm("nop");asm("nop");
	__nop();__nop();
  while(i--)
  {
    if(data&0x80){LCD_SDA_H;}
    else{LCD_SDA_L;}
    LCD_SCL_H; 
//  asm("nop");;
	__nop();;
//	asm("nop");            
    LCD_SCL_L;;    
    data<<=1;    
  }
	//LCD_CS=1;
}

void LCD_WrCmd(byte cmd)
{
	byte i=8;

	//LCD_CS=0;;
	LCD_DC_L;;
	LCD_SCL_L;;
	//asm("nop");   
	while(i--)
	{
		if(cmd&0x80){LCD_SDA_H;}
		else{LCD_SDA_L;;}
		LCD_SCL_H;;
		//asm("nop");;
		__nop();;
		//asm("nop");             
		LCD_SCL_L;;    
		cmd<<=1;;   
	} 	
	//LCD_CS=1;
}

void LCD_Set_Pos(byte x, byte y)
{ 
	LCD_WrCmd(0xb0+y);
	LCD_WrCmd(((x&0xf0)>>4)|0x10);
	LCD_WrCmd((x&0x0f)|0x01); 
} 

void LCD_Fill(byte bmp_data)
{
	byte y,x;

	for(y=0;y<8;y++)
	{
		LCD_WrCmd(0xb0+y);
		LCD_WrCmd(0x01);
		LCD_WrCmd(0x10);
		for(x=0;x<X_WIDTH;x++)
			LCD_WrDat(bmp_data);
	}
}
void LCD_CLS(void)                 //清屏函数
{
	byte y,x;	
	for(y=0;y<8;y++)
	{
		LCD_WrCmd(0xb0+y);
		LCD_WrCmd(0x01);
		LCD_WrCmd(0x10); 
		for(x=0;x<X_WIDTH;x++)
			LCD_WrDat(0);
	}
}


void LCD_CLS_LINE(byte y) 
{
	byte x;
	LCD_WrCmd(0xb0+y);
	LCD_WrCmd(0x01);
	LCD_WrCmd(0x10);
	for(x=0;x<X_WIDTH;x++)
		LCD_WrDat(0);
}

void LCD_DLY_ms(word ms)
{                         
	word c;
	while(ms)
	{
		c=1335;
		while(c--);
		ms--;
	}
	return;
}

void adjust(byte c)
{
	LCD_WrCmd(c);	//指令数据0x0000~0x003f  
}

void SetStartColumn(unsigned char d)
{
	LCD_WrCmd(0x00+d%16);		// Set Lower Column Start Address for Page Addressing Mode
						//   Default => 0x00
	LCD_WrCmd(0x10+d/16);		// Set Higher Column Start Address for Page Addressing Mode
						//   Default => 0x10
}

void SetAddressingMode(unsigned char d)
{
	LCD_WrCmd(0x20);			// Set Memory Addressing Mode
	LCD_WrCmd(d);			//   Default => 0x02
						//     0x00 => Horizontal Addressing Mode
						//     0x01 => Vertical Addressing Mode
						//     0x02 => Page Addressing Mode
}


void SetColumnAddress(unsigned char e, unsigned char f)
{
	LCD_WrCmd(0x21);			// Set Column Address
	LCD_WrCmd(e);			//   Default => 0x00 (Column Start Address)
	LCD_WrCmd(f);			//   Default => 0x7F (Column End Address)
}

void SetPageAddress(unsigned char e, unsigned char f)
{
	LCD_WrCmd(0x22);			// Set Page Address
	LCD_WrCmd(e);			//   Default => 0x00 (Page Start Address)
	LCD_WrCmd(f);			//   Default => 0x07 (Page End Address)
}

void SetStartLine(unsigned char d)
{
	LCD_WrCmd(0x40|d);			// Set Display Start Line
						//   Default => 0x40 (0x00)
}

void SetContrastControl(unsigned char d)
{
	LCD_WrCmd(0x81);			// Set Contrast Control
	LCD_WrCmd(d);			//   Default => 0x7F
}

void Set_Charge_Pump(unsigned char d)
{
	LCD_WrCmd(0x8D);			// Set Charge Pump
	LCD_WrCmd(0x10|d);			//   Default => 0x10
						//     0x10 (0x00) => Disable Charge Pump
						//     0x14 (0x04) => Enable Charge Pump
}

void Set_Segment_Remap(unsigned char d)
{
	LCD_WrCmd(0xA0|d);			// Set Segment Re-Map
						//   Default => 0xA0
						//     0xA0 (0x00) => Column Address 0 Mapped to SEG0
						//     0xA1 (0x01) => Column Address 0 Mapped to SEG127
}

void Set_Entire_Display(unsigned char d)
{
	LCD_WrCmd(0xA4|d);			// Set Entire Display On / Off
						//   Default => 0xA4
						//     0xA4 (0x00) => Normal Display
						//     0xA5 (0x01) => Entire Display On
}

void Set_Inverse_Display(unsigned char d)
{
	LCD_WrCmd(0xA6|d);			// Set Inverse Display On/Off
						//   Default => 0xA6
						//     0xA6 (0x00) => Normal Display
						//     0xA7 (0x01) => Inverse Display On
}

void Set_Multiplex_Ratio(unsigned char d)
{
	LCD_WrCmd(0xA8);			// Set Multiplex Ratio
	LCD_WrCmd(d);			//   Default => 0x3F (1/64 Duty)
}

void Set_Display_On_Off(unsigned char d)
{
	LCD_WrCmd(0xAE|d);			// Set Display On/Off
						//   Default => 0xAE
						//     0xAE (0x00) => Display Off
						//     0xAF (0x01) => Display On
}

void SetStartPage(unsigned char d)
{
	LCD_WrCmd(0xB0|d);			// Set Page Start Address for Page Addressing Mode
						//   Default => 0xB0 (0x00)
}

void Set_Common_Remap(unsigned char d)
{
	LCD_WrCmd(0xC0|d);			// Set COM Output Scan Direction
						//   Default => 0xC0
						//     0xC0 (0x00) => Scan from COM0 to 63
						//     0xC8 (0x08) => Scan from COM63 to 0
}

void Set_Display_Offset(unsigned char d)
{
	LCD_WrCmd(0xD3);			// Set Display Offset
	LCD_WrCmd(d);			//   Default => 0x00
}

void Set_Display_Clock(unsigned char d)
{
	LCD_WrCmd(0xD5);			// Set Display Clock Divide Ratio / Oscillator Frequency
	LCD_WrCmd(d);			//   Default => 0x80
						//     D[3:0] => Display Clock Divider
						//     D[7:4] => Oscillator Frequency
}

void Set_Precharge_Period(unsigned char d)
{
	LCD_WrCmd(0xD9);			// Set Pre-Charge Period
	LCD_WrCmd(d);			//   Default => 0x22 (2 Display Clocks [Phase 2] / 2 Display Clocks [Phase 1])
						//     D[3:0] => Phase 1 Period in 1~15 Display Clocks
						//     D[7:4] => Phase 2 Period in 1~15 Display Clocks
}

void Set_Common_Config(unsigned char d)
{
	LCD_WrCmd(0xDA);			// Set COM Pins Hardware Configuration
	LCD_WrCmd(0x02|d);			//   Default => 0x12 (0x10)
						//     Alternative COM Pin Configuration
						//     Disable COM Left/Right Re-Map
}

void Set_VCOMH(unsigned char d)
{
	LCD_WrCmd(0xDB);			// Set VCOMH Deselect Level
	LCD_WrCmd(d);			//   Default => 0x20 (0.77*VCC)
}

void Set_NOP(void)
{
	LCD_WrCmd(0xE3);			// Command for No Operation
}


//==============================================================
//函数名： void LCD_PutPixel(byte x,byte y)
//功能描述：绘制一个点（x,y）
//参数：真实坐标值(x,y),x的范围0～127，y的范围0～64
//返回：无
//==============================================================
void LCD_PutPixel(byte x,byte y)
{
	byte data1;  //data1当前点的数据 

	LCD_Set_Pos(x,y); 
	data1 = 0x01<<(y%8); 	
	LCD_WrCmd(0xb0+(y>>3));
	LCD_WrCmd(((x&0xf0)>>4)|0x10);
	LCD_WrCmd((x&0x0f)|0x00);
	LCD_WrDat(data1); 	 	
}
//==============================================================
//函数名： void LCD_Rectangle(byte x1,byte y1,
//                   byte x2,byte y2,byte color,byte gif)
//功能描述：绘制一个实心矩形
//参数：左上角坐标（x1,y1）,右下角坐标（x2，y2）
//      其中x1、x2的范围0～127，y1，y2的范围0～63，即真实坐标值
//返回：无
//==============================================================
void LCD_Rectangle(byte x1,byte y1,byte x2,byte y2,byte gif)
{
	byte n; 
		
	LCD_Set_Pos(x1,y1>>3);
	for(n=x1;n<=x2;n++)
	{
		LCD_WrDat(0x01<<(y1%8)); 			
		if(gif == 1) 	
			LCD_DLY_ms(50);
	}  
	LCD_Set_Pos(x1,y2>>3);
	for(n=x1;n<=x2;n++)
	{
		LCD_WrDat(0x01<<(y2%8)); 			
		if(gif == 1) 	
			LCD_DLY_ms(5);
	}
	
}  
//==============================================================
//函数名：LCD_P6x8Str(byte x,byte y,byte *p)
//功能描述：写入一组标准ASCII字符串
//参数：显示的位置（x,y），y为页范围0～7，要显示的字符串
//返回：无
//==============================================================  
void LCD_P6x8Str(byte x,byte y,byte ch[])
{
	byte c=0,i=0,j=0;      
	while (ch[j]!='\0')
	{    
		c =ch[j]-32;
		if(x>126){x=0;y++;}
			LCD_Set_Pos(x,y);    
		for(i=0;i<6;i++)     
			LCD_WrDat(F6x8[c][i]);  
		x+=6;
		j++;
	}
}
//==============================================================
//函数名：LCD_P8x16Str(byte x,byte y,byte *p)
//功能描述：写入一组标准ASCII字符串
//参数：显示的位置（x,y），y为页范围0～7，要显示的字符串
//返回：无
//==============================================================  
void LCD_P8x16Str(byte x,byte y,byte ch[])
{
	byte c=0,i=0,j=0;
		
	while (ch[j]!='\0')
	{    
		c =ch[j]-32;
		if(x>120){x=0;y++;}
		LCD_Set_Pos(x,y);    
		for(i=0;i<8;i++)     
			LCD_WrDat(F8X16[c*16+i]);
		LCD_Set_Pos(x,y+1);    
		for(i=0;i<8;i++)     
			LCD_WrDat(F8X16[c*16+i+8]);  
		x+=8;
		j++;
	}
}

void LCD_P14x16Str(byte x,byte y,byte ch[])
{
	byte wm=0,ii = 0;
	word adder=1; 
	
	while(ch[ii] != '\0')
	{
		wm = 0;
		adder = 1;
		if(x>118){x=0;y++;}
		LCD_Set_Pos(x , y); 
		if(adder != 1)// 显示汉字					
		{
			LCD_Set_Pos(x , y);
			for(wm = 0;wm < 14;wm++)               
			{
				adder += 1;
			}      
			LCD_Set_Pos(x,y + 1); 
			for(wm = 0;wm < 14;wm++)          
			{
				adder += 1;
			}   		
		}
		else			  //显示空白字符			
		{
			ii += 1;
		  LCD_Set_Pos(x,y);
			for(wm = 0;wm < 16;wm++)
			{
					LCD_WrDat(0);
			}
			LCD_Set_Pos(x,y + 1);
			for(wm = 0;wm < 16;wm++)
			{   		
					LCD_WrDat(0);	
			}
		}
		x += 14;
		ii += 2;
	}
}
//输出汉字和字符混合字符串
void LCD_Print(byte x, byte y, byte ch[])
{
	byte ch2[3];
	byte ii=0;        
	while(ch[ii] != '\0')
	{
		if(ch[ii] > 127)
		{
			ch2[0] = ch[ii];
	 		ch2[1] = ch[ii + 1];
			ch2[2] = '\0';			//汉字为两个字节
			LCD_P14x16Str(x , y, ch2);	//显示汉字
			x += 14;
			ii += 2;
		}
		else
		{
			ch2[0] = ch[ii];	
			ch2[1] = '\0';			//字母占一个字节
			LCD_P8x16Str(x , y , ch2);	//显示字母
			x += 8;
			ii+= 1;
		}
	}
} 

//==============================================================
//函数名： void Draw_BMP(byte x,byte y)
//功能描述：显示BMP图片128×64
//参数：起始点坐标(x,y),x的范围0～127，y为页的范围0～7
//返回：无
//==============================================================
void OLED_DrawBMP(byte x0,byte y0,byte x1,byte y1,byte bmp[])
{ 	
	word ii=0;
	byte x,y;

	if(y1%8==0) y=y1/8;      
	else y=y1/8+1;
	for(y=y0;y<=y1;y++)
	{
		LCD_Set_Pos(x0,y);				
		for(x=x0;x<x1;x++)
		{      
			LCD_WrDat(bmp[ii++]);	    	
		}
	}
}

//==============================================================
//函数名：void LED_P6x8Char(byte x,byte y,byte ch);
//功能描述：显示一个6x8标准ASCII字符
//参数：x为显示的横坐标0~122，y为页范围0～7，ch要显示的字符
//返回：无
//============================================================== 
void LED_P6x8Char(int8_t x,int8_t y,int8_t ch)
{
	 int8_t c=0,i=0;     
	   
	c =ch-32;
	if(x>122)
	{
		x=0;
		y++;
	}
	LCD_Set_Pos(x,y);    
	for(i=0;i<6;i++)
	{     
		LCD_WrDat(F6x8[c][i]);  
	}
}

//==============================================================
//函数名：  void LED_PrintValue(uchar x, uchar y, char data);
//功能描述：将一个char型数转换成3位数进行显示
//参数：x的范围为0～122，y为页的范围0～7，data为需要转化显示的数值
//返回：无
//==============================================================
void LED_PrintValueC(uint8_t x, uint8_t y, int8_t data)
{
	uint8_t i,j,k;
	if(data < 0)
	{
		LED_P6x8Char(x,y,'-');
		data = - data;	
	}
//	else
//	{
		//LED_P6x8Char(x,y,'+');
//	}
	i = data/100;
	j = (data%100)/10;
	k = data%10;
	LED_P6x8Char(x+6,y,i+48);
	LED_P6x8Char(x+12,y,j+48);
	LED_P6x8Char(x+18,y,k+48);		
}

//==============================================================
//函数名：  void LED_PrintValueI(uchar x, uchar y, int data);
//功能描述：将一个int型数转换成5位数进行显示
//参数：x的范围为0～120，y为页的范围0～7，data为需要转化显示的数值
//返回：无
//==============================================================
void LED_PrintValueI(uint8_t x, uint8_t y, int16_t data)
{
	uint8_t i,j,k; 
	uint8_t l,m; 	
	if(data < 0)
	{
		LED_P6x8Char(x,y,'-');
		data = - data;	
	}
// 	else
// 	{
// 		LED_P6x8Char(x,y,'+');
// 	}
	
	l  = data/10000;
	m= (data%10000)/1000;
	i = (data%1000)/100;
	j = (data%100)/10;
	k = data%10;
	if(l!=0)
	LED_P6x8Char(x+6,y,l+48);
	if(m!=0)
	LED_P6x8Char(x+12,y,m+48);
	if(i!=0)
	LED_P6x8Char(x+18,y,i+48);
	if(j!=0)
	LED_P6x8Char(x+24,y,j+48);
	if(k!=0)
	LED_P6x8Char(x+30,y,k+48);
}

void LED_PrintValueFP(uint8_t x, uint8_t y, uint16_t data, uint8_t num)
{
	uint8_t m,i,j,k;  	
	LED_P6x8Char(x, y, '.');
	m= data/1000;
	i = (data%1000)/100;
	j = (data%100)/10;
	k = data%10;
	switch(num)
	{
		case 1:  	LED_P6x8Char(x+6,y,k+48);
												break;
		case 2:  	LED_P6x8Char(x+6,y,j+48);
					LED_P6x8Char(x+12,y,k+48);
												break;
		case 3:		LED_P6x8Char(x+6,y,i+48);
					LED_P6x8Char(x+12,y,j+48);
					LED_P6x8Char(x+18,y,k+48);
												break;
		case 4: 	LED_P6x8Char(x+6,y,m+48);
					LED_P6x8Char(x+12,y,i+48);
					LED_P6x8Char(x+18,y,j+48);
					LED_P6x8Char(x+24,y,k+48);
												break;	
	}
}

void LED_PrintValueFP_my(uint8_t x, uint8_t y, uint16_t data, uint8_t num)       //自定义显示超声波的函数
{
	uint8_t m,i,j,k;  	
	// LED_P6x8Char(x, y, '.');
	m= data/1000;
	i = (data%1000)/100;
	j = (data%100)/10;
	k = data%10;
	switch(num)
	{
		case 1:  	LED_P6x8Char(x+6,y,k+48);
												break;
		case 2:  	LED_P6x8Char(x+6,y,j+48);
					LED_P6x8Char(x+12,y,k+48);
												break;
		case 3:		LED_P6x8Char(x+6,y,i+48);
					LED_P6x8Char(x+12,y,j+48);
					LED_P6x8Char(x+18,y,k+48);
												break;
		case 4: 	LED_P6x8Char(x+6,y,m+48);
					LED_P6x8Char(x+12,y,i+48);
					LED_P6x8Char(x+18,y,j+48);
					LED_P6x8Char(x+24,y,k+48);
												break;	
	}
}

//==============================================================
//函数名：   void LED_PrintValueF(uchar x, uchar y, float data, uchar num);
//功能描述：将一个float型数转换成整数部分5位带小数和符号的数据并进行显示
//参数：x的范围为0～62，y为页的范围0～7，data为需要转化显示的数值整数部分最多位5位  num表示保留的小数位0~4
//返回：无
//==============================================================
void LED_PrintValueF(uint8_t x, uint8_t y, float data, uint8_t num)
{
	uint8_t l,m,i,j,k;  //万千百十个
	uint8_t databiti = 6; //整数位数
	uint16_t tempdataui = 0;
	int32_t tempdataii = (int32_t)data; //整数部分
	uint32_t tempdatalp = (uint32_t)((data - (int32_t)data)*10000); //取小数位后4位

	//整数部分显示
	if(data < 0.0000001)  LED_P6x8Char(x, y,'-'); 
	else LED_P6x8Char(x, y,'+');
	if(tempdataii < 0)tempdataii = - tempdataii;  //去掉整数部分负号
	tempdataui = tempdataii;
	l  = tempdataui/10000;
	m= (tempdataui%10000)/1000;
	i = (tempdataui%1000)/100;
	j = (tempdataui%100)/10;
	k = tempdataui%10;
	if (l != 0)  //五位
	{
		LED_P6x8Char(x+6,y,l+48);
		LED_P6x8Char(x+12,y,m+48);
		LED_P6x8Char(x+18,y,i+48);
		LED_P6x8Char(x+24,y,j+48);
		LED_P6x8Char(x+30,y,k+48);
	}
	else if(m != 0) //四位
	{
		databiti = 5;
		LED_P6x8Char(x+6,y,m+48);
		LED_P6x8Char(x+12,y,i+48);
		LED_P6x8Char(x+18,y,j+48);
		LED_P6x8Char(x+24,y,k+48);
	}
	else if(i != 0) //三位
	{
		databiti = 4;
		LED_P6x8Char(x+6,y,i+48);
		LED_P6x8Char(x+12,y,j+48);
		LED_P6x8Char(x+18,y,k+48);
	}
	else if(j != 0) //两位
	{
		databiti = 3;	
		LED_P6x8Char(x+6,y,j+48);
		LED_P6x8Char(x+12,y,k+48);
	}
	else 	
	{
		databiti = 2;
		LED_P6x8Char(x+6,y,k+48);
	}	
	if(tempdatalp < 0)
	tempdatalp = - tempdatalp;	//去掉小数部分负号
	switch(num)
	{
		case 0: break;
		case 1:  LED_PrintValueFP(x + databiti * 6, y, (unsigned int)(tempdatalp / 1000),num);break;
		case 2:  LED_PrintValueFP(x + databiti * 6, y, (unsigned int)(tempdatalp / 100),num);break;
		case 3:  LED_PrintValueFP(x + databiti * 6, y, (unsigned int)(tempdatalp / 10),num);break;
		case 4:  LED_PrintValueFP(x + databiti * 6, y, (unsigned int)(tempdatalp),num);break;					
	}
}

void LCD_show_temp(uint8_t x,uint8_t line,uint32_t var)
{
    LED_P6x8Char(x + 1*6,line,var/10000000 + 48);
    LED_P6x8Char(x + 2*6,line,var%10000000/1000000 + 48);
    LED_P6x8Char(x + 3*6,line,var%1000000/100000 + 48);
	LED_P6x8Char(x + 4*6,line,var%100000/10000 + 48);
	LED_P6x8Char(x + 5*6,line,var%10000/1000 + 48);
	LED_P6x8Char(x + 6*6,line,var%1000/100 + 48);
	LED_P6x8Char(x + 7*6,line,var%100/10 + 48);
	LED_P6x8Char(x + 8*6,line,var%10 + 48);
}

void LCD_show_Data(uint8_t x,uint8_t line,uint16_t var)
{
    LED_P6x8Char(x + 1*6,line,var/10000 + 48);
    LED_P6x8Char(x + 2*6,line,var%10000/1000 + 48);
    LED_P6x8Char(x + 3*6,line,var%1000/100 + 48);
	LED_P6x8Char(x + 4*6,line,var%100/10 + 48);
	LED_P6x8Char(x + 5*6,line,var%10 + 48);
}

void LCD_signal_num(uint8_t x,uint8_t line,uint8_t var)
{
    LED_P6x8Char(x + 1*6,line,var/100 + 48);
    LED_P6x8Char(x + 2*6,line,var%100/10 + 48);
    LED_P6x8Char(x + 3*6,line,var%10 + 48);
}

//////////////////////////////////////////////////////////////////////////////////////////////////////////////
//函数的初始化
///////////////////////////////////////////////////////////////////////////////////////////////////////////
void LCD_Init(void)        
{
	GPIO_InitTypeDef GPIO_InitStructure;	
	RCC_APB2PeriphClockCmd(RCC_APB2Periph_GPIOB, ENABLE);

	GPIO_InitStructure.GPIO_Pin		= GPIO_Pin_5|GPIO_Pin_6|GPIO_Pin_7|GPIO_Pin_8;
	GPIO_InitStructure.GPIO_Speed	= GPIO_Speed_50MHz;	
	GPIO_InitStructure.GPIO_Mode	= GPIO_Mode_Out_PP;
	GPIO_Init(GPIOB,&GPIO_InitStructure);	
	
	LCD_SCL_H;
	//LCD_CS=1;	//预制SLK和SS为高电平   	

	LCD_RST_L;
	LCD_DLY_ms(50);
	LCD_RST_H;

	//从上电到下面开始初始化要有足够的时间，即等待RC复位完毕
	Set_Display_On_Off(0x00);		  // Display Off (0x00/0x01)
	Set_Display_Clock(0x80);		  // Set Clock as 100 Frames/Sec
	Set_Multiplex_Ratio(0x3F);		// 1/64 Duty (0x0F~0x3F)
	Set_Display_Offset(0x00);		  // Shift Mapping RAM Counter (0x00~0x3F)
	SetStartLine(0x00);			      // Set Mapping RAM Display Start Line (0x00~0x3F)
	Set_Charge_Pump(0x04);		    // Enable Embedded DC/DC Converter (0x00/0x04)
	SetAddressingMode(0x02);		  // Set Page Addressing Mode (0x00/0x01/0x02)
	Set_Segment_Remap(0x01);		  // Set SEG/Column Mapping     0x00左右反置 0x01正常
	Set_Common_Remap(0x08);			  // Set COM/Row Scan Direction 0x00上下反置 0x08正常
	Set_Common_Config(0x10);		  // Set Sequential Configuration (0x00/0x10)
	SetContrastControl(Brightness);	// Set SEG Output Current
	Set_Precharge_Period(0xF1);		// Set Pre-Charge as 15 Clocks & Discharge as 1 Clock
	Set_VCOMH(0x40);			        // Set VCOM Deselect Level
	Set_Entire_Display(0x00);		  // Disable Entire Display On (0x00/0x01)
	Set_Inverse_Display(0x00);		// Disable Inverse Display On (0x00/0x01)  
	Set_Display_On_Off(0x01);		  // Display On (0x00/0x01)
	LCD_Fill(0x00);  //初始清屏
	LCD_Set_Pos(0,0); 	
} 

void OLED_Init(void)
{
	LCD_Init();
//	LCD_CLS();
//	LCD_Print(24,0,(unsigned char*)"Smart_Home"); 
//	LCD_P6x8Str(25,3,(unsigned char*)"Initializing!");
//	LCD_P6x8Str(16,5,(unsigned char*)"Please wait for");
//	LCD_P6x8Str(43,6,(unsigned char*)"seconds");
//	LCD_DLY_ms(20000);
//	LCD_CLS();
}

void OLED_Show(void)
{
	LCD_CLS();
	LCD_Print(32,4,(unsigned char*)"Init Done"); 
	LCD_DLY_ms(8000);
	LCD_CLS();
	LCD_DLY_ms(8000);
}

void OLED_RST(void)
{
	LCD_RST_L;
	LCD_DLY_ms(1000);
	LCD_RST_H;
	LCD_Init();
	LCD_P6x8Str(34,0,(unsigned char*)"Smart Home");
	LCD_P6x8Str(0,1,(unsigned char*)"Door:");
//	LCD_P6x8Str(54,1,(unsigned char*)Server_ID);
}
